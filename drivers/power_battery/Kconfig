## drivers/storage_sas3/Kconfig
```kconfig
menu "Storage_Sas3 Drivers"

config STORAGE_SAS3_LSI_C4_R0
    tristate "LSI SAS3 4-channel Rev0"
    default n
    help
      Support for LSI SAS3 4-channel Rev0 (LSI)
      Category: storage_sas3

config STORAGE_SAS3_LSI_C4_R1
    tristate "LSI SAS3 4-channel Rev1"
    default n
    help
      Support for LSI SAS3 4-channel Rev1 (LSI)
      Category: storage_sas3

config STORAGE_SAS3_LSI_C4_R2
    tristate "LSI SAS3 4-channel Rev2"
    default n
    help
      Support for LSI SAS3 4-channel Rev2 (LSI)
      Category: storage_sas3

config STORAGE_SAS3_LSI_C4_R3
    tristate "LSI SAS3 4-channel Rev3"
    default n
    help
      Support for LSI SAS3 4-channel Rev3 (LSI)
      Category: storage_sas3

config STORAGE_SAS3_LSI_C8_R0
    tristate "LSI SAS3 8-channel Rev0"
    default n
    help
      Support for LSI SAS3 8-channel Rev0 (LSI)
      Category: storage_sas3

config STORAGE_SAS3_LSI_C8_R1
    tristate "LSI SAS3 8-channel Rev1"
    default n
    help
      Support for LSI SAS3 8-channel Rev1 (LSI)
      Category: storage_sas3

config STORAGE_SAS3_LSI_C8_R2
    tristate "LSI SAS3 8-channel Rev2"
    default n
    help
      Support for LSI SAS3 8-channel Rev2 (LSI)
      Category: storage_sas3

config STORAGE_SAS3_LSI_C8_R3
    tristate "LSI SAS3 8-channel Rev3"
    default n
    help
      Support for LSI SAS3 8-channel Rev3 (LSI)
      Category: storage_sas3

config STORAGE_SAS3_LSI_C16_R0
    tristate "LSI SAS3 16-channel Rev0"
    default n
    help
      Support for LSI SAS3 16-channel Rev0 (LSI)
      Category: storage_sas3

config STORAGE_SAS3_LSI_C16_R1
    tristate "LSI SAS3 16-channel Rev1"
    default n
    help
      Support for LSI SAS3 16-channel Rev1 (LSI)
      Category: storage_sas3

config STORAGE_SAS3_LSI_C16_R2
    tristate "LSI SAS3 16-channel Rev2"
    default n
    help
      Support for LSI SAS3 16-channel Rev2 (LSI)
      Category: storage_sas3

config STORAGE_SAS3_LSI_C16_R3
    tristate "LSI SAS3 16-channel Rev3"
    default n
    help
      Support for LSI SAS3 16-channel Rev3 (LSI)
      Category: storage_sas3

config STORAGE_SAS3_ADAPTEC_C4_R0
    tristate "Adaptec SAS3 4-channel Rev0"
    default n
    help
      Support for Adaptec SAS3 4-channel Rev0 (Adaptec)
      Category: storage_sas3

config STORAGE_SAS3_ADAPTEC_C4_R1
    tristate "Adaptec SAS3 4-channel Rev1"
    default n
    help
      Support for Adaptec SAS3 4-channel Rev1 (Adaptec)
      Category: storage_sas3

config STORAGE_SAS3_ADAPTEC_C4_R2
    tristate "Adaptec SAS3 4-channel Rev2"
    default n
    help
      Support for Adaptec SAS3 4-channel Rev2 (Adaptec)
      Category: storage_sas3

config STORAGE_SAS3_ADAPTEC_C4_R3
    tristate "Adaptec SAS3 4-channel Rev3"
    default n
    help
      Support for Adaptec SAS3 4-channel Rev3 (Adaptec)
      Category: storage_sas3

config STORAGE_SAS3_ADAPTEC_C8_R0
    tristate "Adaptec SAS3 8-channel Rev0"
    default n
    help
      Support for Adaptec SAS3 8-channel Rev0 (Adaptec)
      Category: storage_sas3

config STORAGE_SAS3_ADAPTEC_C8_R1
    tristate "Adaptec SAS3 8-channel Rev1"
    default n
    help
      Support for Adaptec SAS3 8-channel Rev1 (Adaptec)
      Category: storage_sas3

config STORAGE_SAS3_ADAPTEC_C8_R2
    tristate "Adaptec SAS3 8-channel Rev2"
    default n
    help
      Support for Adaptec SAS3 8-channel Rev2 (Adaptec)
      Category: storage_sas3

config STORAGE_SAS3_ADAPTEC_C8_R3
    tristate "Adaptec SAS3 8-channel Rev3"
    default n
    help
      Support for Adaptec SAS3 8-channel Rev3 (Adaptec)
      Category: storage_sas3

config STORAGE_SAS3_ADAPTEC_C16_R0
    tristate "Adaptec SAS3 16-channel Rev0"
    default n
    help
      Support for Adaptec SAS3 16-channel Rev0 (Adaptec)
      Category: storage_sas3

config STORAGE_SAS3_ADAPTEC_C16_R1
    tristate "Adaptec SAS3 16-channel Rev1"
    default n
    help
      Support for Adaptec SAS3 16-channel Rev1 (Adaptec)
      Category: storage_sas3

config STORAGE_SAS3_ADAPTEC_C16_R2
    tristate "Adaptec SAS3 16-channel Rev2"
    default n
    help
      Support for Adaptec SAS3 16-channel Rev2 (Adaptec)
      Category: storage_sas3

config STORAGE_SAS3_ADAPTEC_C16_R3
    tristate "Adaptec SAS3 16-channel Rev3"
    default n
    help
      Support for Adaptec SAS3 16-channel Rev3 (Adaptec)
      Category: storage_sas3

config STORAGE_SAS3_BROADCOM_C4_R0
    tristate "Broadcom SAS3 4-channel Rev0"
    default n
    help
      Support for Broadcom SAS3 4-channel Rev0 (Broadcom)
      Category: storage_sas3

config STORAGE_SAS3_BROADCOM_C4_R1
    tristate "Broadcom SAS3 4-channel Rev1"
    default n
    help
      Support for Broadcom SAS3 4-channel Rev1 (Broadcom)
      Category: storage_sas3

config STORAGE_SAS3_BROADCOM_C4_R2
    tristate "Broadcom SAS3 4-channel Rev2"
    default n
    help
      Support for Broadcom SAS3 4-channel Rev2 (Broadcom)
      Category: storage_sas3

config STORAGE_SAS3_BROADCOM_C4_R3
    tristate "Broadcom SAS3 4-channel Rev3"
    default n
    help
      Support for Broadcom SAS3 4-channel Rev3 (Broadcom)
      Category: storage_sas3

config STORAGE_SAS3_BROADCOM_C8_R0
    tristate "Broadcom SAS3 8-channel Rev0"
    default n
    help
      Support for Broadcom SAS3 8-channel Rev0 (Broadcom)
      Category: storage_sas3

config STORAGE_SAS3_BROADCOM_C8_R1
    tristate "Broadcom SAS3 8-channel Rev1"
    default n
    help
      Support for Broadcom SAS3 8-channel Rev1 (Broadcom)
      Category: storage_sas3

config STORAGE_SAS3_BROADCOM_C8_R2
    tristate "Broadcom SAS3 8-channel Rev2"
    default n
    help
      Support for Broadcom SAS3 8-channel Rev2 (Broadcom)
      Category: storage_sas3

config STORAGE_SAS3_BROADCOM_C8_R3
    tristate "Broadcom SAS3 8-channel Rev3"
    default n
    help
      Support for Broadcom SAS3 8-channel Rev3 (Broadcom)
      Category: storage_sas3

config STORAGE_SAS3_BROADCOM_C16_R0
    tristate "Broadcom SAS3 16-channel Rev0"
    default n
    help
      Support for Broadcom SAS3 16-channel Rev0 (Broadcom)
      Category: storage_sas3

config STORAGE_SAS3_BROADCOM_C16_R1
    tristate "Broadcom SAS3 16-channel Rev1"
    default n
    help
      Support for Broadcom SAS3 16-channel Rev1 (Broadcom)
      Category: storage_sas3

config STORAGE_SAS3_BROADCOM_C16_R2
    tristate "Broadcom SAS3 16-channel Rev2"
    default n
    help
      Support for Broadcom SAS3 16-channel Rev2 (Broadcom)
      Category: storage_sas3

config STORAGE_SAS3_BROADCOM_C16_R3
    tristate "Broadcom SAS3 16-channel Rev3"
    default n
    help
      Support for Broadcom SAS3 16-channel Rev3 (Broadcom)
      Category: storage_sas3

config STORAGE_SAS3_MARVELL_C4_R0
    tristate "Marvell SAS3 4-channel Rev0"
    default n
    help
      Support for Marvell SAS3 4-channel Rev0 (Marvell)
      Category: storage_sas3

config STORAGE_SAS3_MARVELL_C4_R1
    tristate "Marvell SAS3 4-channel Rev1"
    default n
    help
      Support for Marvell SAS3 4-channel Rev1 (Marvell)
      Category: storage_sas3

config STORAGE_SAS3_MARVELL_C4_R2
    tristate "Marvell SAS3 4-channel Rev2"
    default n
    help
      Support for Marvell SAS3 4-channel Rev2 (Marvell)
      Category: storage_sas3

config STORAGE_SAS3_MARVELL_C4_R3
    tristate "Marvell SAS3 4-channel Rev3"
    default n
    help
      Support for Marvell SAS3 4-channel Rev3 (Marvell)
      Category: storage_sas3

config STORAGE_SAS3_MARVELL_C8_R0
    tristate "Marvell SAS3 8-channel Rev0"
    default n
    help
      Support for Marvell SAS3 8-channel Rev0 (Marvell)
      Category: storage_sas3

config STORAGE_SAS3_MARVELL_C8_R1
    tristate "Marvell SAS3 8-channel Rev1"
    default n
    help
      Support for Marvell SAS3 8-channel Rev1 (Marvell)
      Category: storage_sas3

config STORAGE_SAS3_MARVELL_C8_R2
    tristate "Marvell SAS3 8-channel Rev2"
    default n
    help
      Support for Marvell SAS3 8-channel Rev2 (Marvell)
      Category: storage_sas3

config STORAGE_SAS3_MARVELL_C8_R3
    tristate "Marvell SAS3 8-channel Rev3"
    default n
    help
      Support for Marvell SAS3 8-channel Rev3 (Marvell)
      Category: storage_sas3

config STORAGE_SAS3_MARVELL_C16_R0
    tristate "Marvell SAS3 16-channel Rev0"
    default n
    help
      Support for Marvell SAS3 16-channel Rev0 (Marvell)
      Category: storage_sas3

config STORAGE_SAS3_MARVELL_C16_R1
    tristate "Marvell SAS3 16-channel Rev1"
    default n
    help
      Support for Marvell SAS3 16-channel Rev1 (Marvell)
      Category: storage_sas3

config STORAGE_SAS3_MARVELL_C16_R2
    tristate "Marvell SAS3 16-channel Rev2"
    default n
    help
      Support for Marvell SAS3 16-channel Rev2 (Marvell)
      Category: storage_sas3

config STORAGE_SAS3_MARVELL_C16_R3
    tristate "Marvell SAS3 16-channel Rev3"
    default n
    help
      Support for Marvell SAS3 16-channel Rev3 (Marvell)
      Category: storage_sas3

endmenu
```
