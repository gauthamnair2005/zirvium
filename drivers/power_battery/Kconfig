## drivers/sensor_proximity/Kconfig
```kconfig
menu "Sensor_Proximity Drivers"

config SENSOR_PROXIMITY_APDS9960_I2C_R0
    tristate "Proximity APDS9960 I2C Rev0"
    default n
    help
      Support for Proximity APDS9960 I2C Rev0 (APDS9960)
      Category: sensor_proximity

config SENSOR_PROXIMITY_APDS9960_I2C_R1
    tristate "Proximity APDS9960 I2C Rev1"
    default n
    help
      Support for Proximity APDS9960 I2C Rev1 (APDS9960)
      Category: sensor_proximity

config SENSOR_PROXIMITY_APDS9960_I2C_R2
    tristate "Proximity APDS9960 I2C Rev2"
    default n
    help
      Support for Proximity APDS9960 I2C Rev2 (APDS9960)
      Category: sensor_proximity

config SENSOR_PROXIMITY_APDS9960_I2C_R3
    tristate "Proximity APDS9960 I2C Rev3"
    default n
    help
      Support for Proximity APDS9960 I2C Rev3 (APDS9960)
      Category: sensor_proximity

config SENSOR_PROXIMITY_APDS9960_I2C_R4
    tristate "Proximity APDS9960 I2C Rev4"
    default n
    help
      Support for Proximity APDS9960 I2C Rev4 (APDS9960)
      Category: sensor_proximity

config SENSOR_PROXIMITY_APDS9960_I2C_R5
    tristate "Proximity APDS9960 I2C Rev5"
    default n
    help
      Support for Proximity APDS9960 I2C Rev5 (APDS9960)
      Category: sensor_proximity

config SENSOR_PROXIMITY_APDS9960_I2C_R6
    tristate "Proximity APDS9960 I2C Rev6"
    default n
    help
      Support for Proximity APDS9960 I2C Rev6 (APDS9960)
      Category: sensor_proximity

config SENSOR_PROXIMITY_APDS9960_I2C_R7
    tristate "Proximity APDS9960 I2C Rev7"
    default n
    help
      Support for Proximity APDS9960 I2C Rev7 (APDS9960)
      Category: sensor_proximity

config SENSOR_PROXIMITY_APDS9960_SPI_R0
    tristate "Proximity APDS9960 SPI Rev0"
    default n
    help
      Support for Proximity APDS9960 SPI Rev0 (APDS9960)
      Category: sensor_proximity

config SENSOR_PROXIMITY_APDS9960_SPI_R1
    tristate "Proximity APDS9960 SPI Rev1"
    default n
    help
      Support for Proximity APDS9960 SPI Rev1 (APDS9960)
      Category: sensor_proximity

config SENSOR_PROXIMITY_APDS9960_SPI_R2
    tristate "Proximity APDS9960 SPI Rev2"
    default n
    help
      Support for Proximity APDS9960 SPI Rev2 (APDS9960)
      Category: sensor_proximity

config SENSOR_PROXIMITY_APDS9960_SPI_R3
    tristate "Proximity APDS9960 SPI Rev3"
    default n
    help
      Support for Proximity APDS9960 SPI Rev3 (APDS9960)
      Category: sensor_proximity

config SENSOR_PROXIMITY_APDS9960_SPI_R4
    tristate "Proximity APDS9960 SPI Rev4"
    default n
    help
      Support for Proximity APDS9960 SPI Rev4 (APDS9960)
      Category: sensor_proximity

config SENSOR_PROXIMITY_APDS9960_SPI_R5
    tristate "Proximity APDS9960 SPI Rev5"
    default n
    help
      Support for Proximity APDS9960 SPI Rev5 (APDS9960)
      Category: sensor_proximity

config SENSOR_PROXIMITY_APDS9960_SPI_R6
    tristate "Proximity APDS9960 SPI Rev6"
    default n
    help
      Support for Proximity APDS9960 SPI Rev6 (APDS9960)
      Category: sensor_proximity

config SENSOR_PROXIMITY_APDS9960_SPI_R7
    tristate "Proximity APDS9960 SPI Rev7"
    default n
    help
      Support for Proximity APDS9960 SPI Rev7 (APDS9960)
      Category: sensor_proximity

config SENSOR_PROXIMITY_APDS9960_UART_R0
    tristate "Proximity APDS9960 UART Rev0"
    default n
    help
      Support for Proximity APDS9960 UART Rev0 (APDS9960)
      Category: sensor_proximity

config SENSOR_PROXIMITY_APDS9960_UART_R1
    tristate "Proximity APDS9960 UART Rev1"
    default n
    help
      Support for Proximity APDS9960 UART Rev1 (APDS9960)
      Category: sensor_proximity

config SENSOR_PROXIMITY_APDS9960_UART_R2
    tristate "Proximity APDS9960 UART Rev2"
    default n
    help
      Support for Proximity APDS9960 UART Rev2 (APDS9960)
      Category: sensor_proximity

config SENSOR_PROXIMITY_APDS9960_UART_R3
    tristate "Proximity APDS9960 UART Rev3"
    default n
    help
      Support for Proximity APDS9960 UART Rev3 (APDS9960)
      Category: sensor_proximity

config SENSOR_PROXIMITY_APDS9960_UART_R4
    tristate "Proximity APDS9960 UART Rev4"
    default n
    help
      Support for Proximity APDS9960 UART Rev4 (APDS9960)
      Category: sensor_proximity

config SENSOR_PROXIMITY_APDS9960_UART_R5
    tristate "Proximity APDS9960 UART Rev5"
    default n
    help
      Support for Proximity APDS9960 UART Rev5 (APDS9960)
      Category: sensor_proximity

config SENSOR_PROXIMITY_APDS9960_UART_R6
    tristate "Proximity APDS9960 UART Rev6"
    default n
    help
      Support for Proximity APDS9960 UART Rev6 (APDS9960)
      Category: sensor_proximity

config SENSOR_PROXIMITY_APDS9960_UART_R7
    tristate "Proximity APDS9960 UART Rev7"
    default n
    help
      Support for Proximity APDS9960 UART Rev7 (APDS9960)
      Category: sensor_proximity

config SENSOR_PROXIMITY_VCNL4000_I2C_R0
    tristate "Proximity VCNL4000 I2C Rev0"
    default n
    help
      Support for Proximity VCNL4000 I2C Rev0 (VCNL4000)
      Category: sensor_proximity

config SENSOR_PROXIMITY_VCNL4000_I2C_R1
    tristate "Proximity VCNL4000 I2C Rev1"
    default n
    help
      Support for Proximity VCNL4000 I2C Rev1 (VCNL4000)
      Category: sensor_proximity

config SENSOR_PROXIMITY_VCNL4000_I2C_R2
    tristate "Proximity VCNL4000 I2C Rev2"
    default n
    help
      Support for Proximity VCNL4000 I2C Rev2 (VCNL4000)
      Category: sensor_proximity

config SENSOR_PROXIMITY_VCNL4000_I2C_R3
    tristate "Proximity VCNL4000 I2C Rev3"
    default n
    help
      Support for Proximity VCNL4000 I2C Rev3 (VCNL4000)
      Category: sensor_proximity

config SENSOR_PROXIMITY_VCNL4000_I2C_R4
    tristate "Proximity VCNL4000 I2C Rev4"
    default n
    help
      Support for Proximity VCNL4000 I2C Rev4 (VCNL4000)
      Category: sensor_proximity

config SENSOR_PROXIMITY_VCNL4000_I2C_R5
    tristate "Proximity VCNL4000 I2C Rev5"
    default n
    help
      Support for Proximity VCNL4000 I2C Rev5 (VCNL4000)
      Category: sensor_proximity

config SENSOR_PROXIMITY_VCNL4000_I2C_R6
    tristate "Proximity VCNL4000 I2C Rev6"
    default n
    help
      Support for Proximity VCNL4000 I2C Rev6 (VCNL4000)
      Category: sensor_proximity

config SENSOR_PROXIMITY_VCNL4000_I2C_R7
    tristate "Proximity VCNL4000 I2C Rev7"
    default n
    help
      Support for Proximity VCNL4000 I2C Rev7 (VCNL4000)
      Category: sensor_proximity

config SENSOR_PROXIMITY_VCNL4000_SPI_R0
    tristate "Proximity VCNL4000 SPI Rev0"
    default n
    help
      Support for Proximity VCNL4000 SPI Rev0 (VCNL4000)
      Category: sensor_proximity

config SENSOR_PROXIMITY_VCNL4000_SPI_R1
    tristate "Proximity VCNL4000 SPI Rev1"
    default n
    help
      Support for Proximity VCNL4000 SPI Rev1 (VCNL4000)
      Category: sensor_proximity

config SENSOR_PROXIMITY_VCNL4000_SPI_R2
    tristate "Proximity VCNL4000 SPI Rev2"
    default n
    help
      Support for Proximity VCNL4000 SPI Rev2 (VCNL4000)
      Category: sensor_proximity

config SENSOR_PROXIMITY_VCNL4000_SPI_R3
    tristate "Proximity VCNL4000 SPI Rev3"
    default n
    help
      Support for Proximity VCNL4000 SPI Rev3 (VCNL4000)
      Category: sensor_proximity

config SENSOR_PROXIMITY_VCNL4000_SPI_R4
    tristate "Proximity VCNL4000 SPI Rev4"
    default n
    help
      Support for Proximity VCNL4000 SPI Rev4 (VCNL4000)
      Category: sensor_proximity

config SENSOR_PROXIMITY_VCNL4000_SPI_R5
    tristate "Proximity VCNL4000 SPI Rev5"
    default n
    help
      Support for Proximity VCNL4000 SPI Rev5 (VCNL4000)
      Category: sensor_proximity

config SENSOR_PROXIMITY_VCNL4000_SPI_R6
    tristate "Proximity VCNL4000 SPI Rev6"
    default n
    help
      Support for Proximity VCNL4000 SPI Rev6 (VCNL4000)
      Category: sensor_proximity

config SENSOR_PROXIMITY_VCNL4000_SPI_R7
    tristate "Proximity VCNL4000 SPI Rev7"
    default n
    help
      Support for Proximity VCNL4000 SPI Rev7 (VCNL4000)
      Category: sensor_proximity

config SENSOR_PROXIMITY_VCNL4000_UART_R0
    tristate "Proximity VCNL4000 UART Rev0"
    default n
    help
      Support for Proximity VCNL4000 UART Rev0 (VCNL4000)
      Category: sensor_proximity

config SENSOR_PROXIMITY_VCNL4000_UART_R1
    tristate "Proximity VCNL4000 UART Rev1"
    default n
    help
      Support for Proximity VCNL4000 UART Rev1 (VCNL4000)
      Category: sensor_proximity

config SENSOR_PROXIMITY_VCNL4000_UART_R2
    tristate "Proximity VCNL4000 UART Rev2"
    default n
    help
      Support for Proximity VCNL4000 UART Rev2 (VCNL4000)
      Category: sensor_proximity

config SENSOR_PROXIMITY_VCNL4000_UART_R3
    tristate "Proximity VCNL4000 UART Rev3"
    default n
    help
      Support for Proximity VCNL4000 UART Rev3 (VCNL4000)
      Category: sensor_proximity

config SENSOR_PROXIMITY_VCNL4000_UART_R4
    tristate "Proximity VCNL4000 UART Rev4"
    default n
    help
      Support for Proximity VCNL4000 UART Rev4 (VCNL4000)
      Category: sensor_proximity

config SENSOR_PROXIMITY_VCNL4000_UART_R5
    tristate "Proximity VCNL4000 UART Rev5"
    default n
    help
      Support for Proximity VCNL4000 UART Rev5 (VCNL4000)
      Category: sensor_proximity

config SENSOR_PROXIMITY_VCNL4000_UART_R6
    tristate "Proximity VCNL4000 UART Rev6"
    default n
    help
      Support for Proximity VCNL4000 UART Rev6 (VCNL4000)
      Category: sensor_proximity

config SENSOR_PROXIMITY_VCNL4000_UART_R7
    tristate "Proximity VCNL4000 UART Rev7"
    default n
    help
      Support for Proximity VCNL4000 UART Rev7 (VCNL4000)
      Category: sensor_proximity

config SENSOR_PROXIMITY_GP2AP_I2C_R0
    tristate "Proximity GP2AP I2C Rev0"
    default n
    help
      Support for Proximity GP2AP I2C Rev0 (GP2AP)
      Category: sensor_proximity

config SENSOR_PROXIMITY_GP2AP_I2C_R1
    tristate "Proximity GP2AP I2C Rev1"
    default n
    help
      Support for Proximity GP2AP I2C Rev1 (GP2AP)
      Category: sensor_proximity

config SENSOR_PROXIMITY_GP2AP_I2C_R2
    tristate "Proximity GP2AP I2C Rev2"
    default n
    help
      Support for Proximity GP2AP I2C Rev2 (GP2AP)
      Category: sensor_proximity

config SENSOR_PROXIMITY_GP2AP_I2C_R3
    tristate "Proximity GP2AP I2C Rev3"
    default n
    help
      Support for Proximity GP2AP I2C Rev3 (GP2AP)
      Category: sensor_proximity

config SENSOR_PROXIMITY_GP2AP_I2C_R4
    tristate "Proximity GP2AP I2C Rev4"
    default n
    help
      Support for Proximity GP2AP I2C Rev4 (GP2AP)
      Category: sensor_proximity

config SENSOR_PROXIMITY_GP2AP_I2C_R5
    tristate "Proximity GP2AP I2C Rev5"
    default n
    help
      Support for Proximity GP2AP I2C Rev5 (GP2AP)
      Category: sensor_proximity

config SENSOR_PROXIMITY_GP2AP_I2C_R6
    tristate "Proximity GP2AP I2C Rev6"
    default n
    help
      Support for Proximity GP2AP I2C Rev6 (GP2AP)
      Category: sensor_proximity

config SENSOR_PROXIMITY_GP2AP_I2C_R7
    tristate "Proximity GP2AP I2C Rev7"
    default n
    help
      Support for Proximity GP2AP I2C Rev7 (GP2AP)
      Category: sensor_proximity

config SENSOR_PROXIMITY_GP2AP_SPI_R0
    tristate "Proximity GP2AP SPI Rev0"
    default n
    help
      Support for Proximity GP2AP SPI Rev0 (GP2AP)
      Category: sensor_proximity

config SENSOR_PROXIMITY_GP2AP_SPI_R1
    tristate "Proximity GP2AP SPI Rev1"
    default n
    help
      Support for Proximity GP2AP SPI Rev1 (GP2AP)
      Category: sensor_proximity

config SENSOR_PROXIMITY_GP2AP_SPI_R2
    tristate "Proximity GP2AP SPI Rev2"
    default n
    help
      Support for Proximity GP2AP SPI Rev2 (GP2AP)
      Category: sensor_proximity

config SENSOR_PROXIMITY_GP2AP_SPI_R3
    tristate "Proximity GP2AP SPI Rev3"
    default n
    help
      Support for Proximity GP2AP SPI Rev3 (GP2AP)
      Category: sensor_proximity

config SENSOR_PROXIMITY_GP2AP_SPI_R4
    tristate "Proximity GP2AP SPI Rev4"
    default n
    help
      Support for Proximity GP2AP SPI Rev4 (GP2AP)
      Category: sensor_proximity

config SENSOR_PROXIMITY_GP2AP_SPI_R5
    tristate "Proximity GP2AP SPI Rev5"
    default n
    help
      Support for Proximity GP2AP SPI Rev5 (GP2AP)
      Category: sensor_proximity

config SENSOR_PROXIMITY_GP2AP_SPI_R6
    tristate "Proximity GP2AP SPI Rev6"
    default n
    help
      Support for Proximity GP2AP SPI Rev6 (GP2AP)
      Category: sensor_proximity

config SENSOR_PROXIMITY_GP2AP_SPI_R7
    tristate "Proximity GP2AP SPI Rev7"
    default n
    help
      Support for Proximity GP2AP SPI Rev7 (GP2AP)
      Category: sensor_proximity

config SENSOR_PROXIMITY_GP2AP_UART_R0
    tristate "Proximity GP2AP UART Rev0"
    default n
    help
      Support for Proximity GP2AP UART Rev0 (GP2AP)
      Category: sensor_proximity

config SENSOR_PROXIMITY_GP2AP_UART_R1
    tristate "Proximity GP2AP UART Rev1"
    default n
    help
      Support for Proximity GP2AP UART Rev1 (GP2AP)
      Category: sensor_proximity

config SENSOR_PROXIMITY_GP2AP_UART_R2
    tristate "Proximity GP2AP UART Rev2"
    default n
    help
      Support for Proximity GP2AP UART Rev2 (GP2AP)
      Category: sensor_proximity

config SENSOR_PROXIMITY_GP2AP_UART_R3
    tristate "Proximity GP2AP UART Rev3"
    default n
    help
      Support for Proximity GP2AP UART Rev3 (GP2AP)
      Category: sensor_proximity

config SENSOR_PROXIMITY_GP2AP_UART_R4
    tristate "Proximity GP2AP UART Rev4"
    default n
    help
      Support for Proximity GP2AP UART Rev4 (GP2AP)
      Category: sensor_proximity

config SENSOR_PROXIMITY_GP2AP_UART_R5
    tristate "Proximity GP2AP UART Rev5"
    default n
    help
      Support for Proximity GP2AP UART Rev5 (GP2AP)
      Category: sensor_proximity

config SENSOR_PROXIMITY_GP2AP_UART_R6
    tristate "Proximity GP2AP UART Rev6"
    default n
    help
      Support for Proximity GP2AP UART Rev6 (GP2AP)
      Category: sensor_proximity

config SENSOR_PROXIMITY_GP2AP_UART_R7
    tristate "Proximity GP2AP UART Rev7"
    default n
    help
      Support for Proximity GP2AP UART Rev7 (GP2AP)
      Category: sensor_proximity

config SENSOR_PROXIMITY_TMD2772_I2C_R0
    tristate "Proximity TMD2772 I2C Rev0"
    default n
    help
      Support for Proximity TMD2772 I2C Rev0 (TMD2772)
      Category: sensor_proximity

config SENSOR_PROXIMITY_TMD2772_I2C_R1
    tristate "Proximity TMD2772 I2C Rev1"
    default n
    help
      Support for Proximity TMD2772 I2C Rev1 (TMD2772)
      Category: sensor_proximity

config SENSOR_PROXIMITY_TMD2772_I2C_R2
    tristate "Proximity TMD2772 I2C Rev2"
    default n
    help
      Support for Proximity TMD2772 I2C Rev2 (TMD2772)
      Category: sensor_proximity

config SENSOR_PROXIMITY_TMD2772_I2C_R3
    tristate "Proximity TMD2772 I2C Rev3"
    default n
    help
      Support for Proximity TMD2772 I2C Rev3 (TMD2772)
      Category: sensor_proximity

config SENSOR_PROXIMITY_TMD2772_I2C_R4
    tristate "Proximity TMD2772 I2C Rev4"
    default n
    help
      Support for Proximity TMD2772 I2C Rev4 (TMD2772)
      Category: sensor_proximity

config SENSOR_PROXIMITY_TMD2772_I2C_R5
    tristate "Proximity TMD2772 I2C Rev5"
    default n
    help
      Support for Proximity TMD2772 I2C Rev5 (TMD2772)
      Category: sensor_proximity

config SENSOR_PROXIMITY_TMD2772_I2C_R6
    tristate "Proximity TMD2772 I2C Rev6"
    default n
    help
      Support for Proximity TMD2772 I2C Rev6 (TMD2772)
      Category: sensor_proximity

config SENSOR_PROXIMITY_TMD2772_I2C_R7
    tristate "Proximity TMD2772 I2C Rev7"
    default n
    help
      Support for Proximity TMD2772 I2C Rev7 (TMD2772)
      Category: sensor_proximity

config SENSOR_PROXIMITY_TMD2772_SPI_R0
    tristate "Proximity TMD2772 SPI Rev0"
    default n
    help
      Support for Proximity TMD2772 SPI Rev0 (TMD2772)
      Category: sensor_proximity

config SENSOR_PROXIMITY_TMD2772_SPI_R1
    tristate "Proximity TMD2772 SPI Rev1"
    default n
    help
      Support for Proximity TMD2772 SPI Rev1 (TMD2772)
      Category: sensor_proximity

config SENSOR_PROXIMITY_TMD2772_SPI_R2
    tristate "Proximity TMD2772 SPI Rev2"
    default n
    help
      Support for Proximity TMD2772 SPI Rev2 (TMD2772)
      Category: sensor_proximity

config SENSOR_PROXIMITY_TMD2772_SPI_R3
    tristate "Proximity TMD2772 SPI Rev3"
    default n
    help
      Support for Proximity TMD2772 SPI Rev3 (TMD2772)
      Category: sensor_proximity

config SENSOR_PROXIMITY_TMD2772_SPI_R4
    tristate "Proximity TMD2772 SPI Rev4"
    default n
    help
      Support for Proximity TMD2772 SPI Rev4 (TMD2772)
      Category: sensor_proximity

config SENSOR_PROXIMITY_TMD2772_SPI_R5
    tristate "Proximity TMD2772 SPI Rev5"
    default n
    help
      Support for Proximity TMD2772 SPI Rev5 (TMD2772)
      Category: sensor_proximity

config SENSOR_PROXIMITY_TMD2772_SPI_R6
    tristate "Proximity TMD2772 SPI Rev6"
    default n
    help
      Support for Proximity TMD2772 SPI Rev6 (TMD2772)
      Category: sensor_proximity

config SENSOR_PROXIMITY_TMD2772_SPI_R7
    tristate "Proximity TMD2772 SPI Rev7"
    default n
    help
      Support for Proximity TMD2772 SPI Rev7 (TMD2772)
      Category: sensor_proximity

config SENSOR_PROXIMITY_TMD2772_UART_R0
    tristate "Proximity TMD2772 UART Rev0"
    default n
    help
      Support for Proximity TMD2772 UART Rev0 (TMD2772)
      Category: sensor_proximity

config SENSOR_PROXIMITY_TMD2772_UART_R1
    tristate "Proximity TMD2772 UART Rev1"
    default n
    help
      Support for Proximity TMD2772 UART Rev1 (TMD2772)
      Category: sensor_proximity

config SENSOR_PROXIMITY_TMD2772_UART_R2
    tristate "Proximity TMD2772 UART Rev2"
    default n
    help
      Support for Proximity TMD2772 UART Rev2 (TMD2772)
      Category: sensor_proximity

config SENSOR_PROXIMITY_TMD2772_UART_R3
    tristate "Proximity TMD2772 UART Rev3"
    default n
    help
      Support for Proximity TMD2772 UART Rev3 (TMD2772)
      Category: sensor_proximity

config SENSOR_PROXIMITY_TMD2772_UART_R4
    tristate "Proximity TMD2772 UART Rev4"
    default n
    help
      Support for Proximity TMD2772 UART Rev4 (TMD2772)
      Category: sensor_proximity

config SENSOR_PROXIMITY_TMD2772_UART_R5
    tristate "Proximity TMD2772 UART Rev5"
    default n
    help
      Support for Proximity TMD2772 UART Rev5 (TMD2772)
      Category: sensor_proximity

config SENSOR_PROXIMITY_TMD2772_UART_R6
    tristate "Proximity TMD2772 UART Rev6"
    default n
    help
      Support for Proximity TMD2772 UART Rev6 (TMD2772)
      Category: sensor_proximity

config SENSOR_PROXIMITY_TMD2772_UART_R7
    tristate "Proximity TMD2772 UART Rev7"
    default n
    help
      Support for Proximity TMD2772 UART Rev7 (TMD2772)
      Category: sensor_proximity

endmenu
```
